## src/meta-rpi-semaforo/conf/layer.conf
```bitbake
BBFILE_COLLECTIONS += "meta-rpi-semaforo"
BBFILE_PATTERN_meta-rpi-semaforo = "^${LAYERDIR}/"
BBFILES += "${LAYERDIR}/recipes-*/*/*.bb \
            ${LAYERDIR}/recipes-*/*/*.bbappend"
BBFILE_PRIORITY_meta-rpi-semaforo = "6"
LAYERSERIES_COMPAT_meta-rpi-semaforo = "kirkstone zeus"
```
